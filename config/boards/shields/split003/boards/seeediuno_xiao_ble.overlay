&i2c0 {
    status = "okay";
    clock-frequency = <I2C_BITRATE_FAST>;

    mcp_io: mcp23017@21 {
        compatible = "microchip,mcp230xx";
        status = "okay";
        gpio-controller;
        reg = <0x21>;
        #gpio-cells = <2>;
        ngpios = <16>;
        reset-gpios = <&xiao_d 6 GPIO_ACTIVE_LOW>;
    };
};